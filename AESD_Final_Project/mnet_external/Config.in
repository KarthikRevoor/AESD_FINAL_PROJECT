## AESD_Final_Project/mnet_external/Config.in
```kconfig
menu "mnet external options"
source "$BR2_EXTERNAL_MNET_EXTERNAL_PATH/package/mnet/Config.in"
source "$BR2_EXTERNAL_MNET_EXTERNAL_PATH/package/bme280/Config.in"
source "$BR2_EXTERNAL_MNET_EXTERNAL_PATH/package/python-rpi-epd2in7/Config.in"
source "$BR2_EXTERNAL_MNET_EXTERNAL_PATH/package/gpiozero/Config.in"
source "$BR2_EXTERNAL_MNET_EXTERNAL_PATH/package/colourzero/Config.in"
source "$BR2_EXTERNAL_MNET_EXTERNAL_PATH/package/lcd_1602/Config.in"

endmenu
```

## AESD_Final_Project/mnet_external/package/lcd_1602/Config.in
```kconfig
config BR2_PACKAGE_LCD_1602
    bool "lcd_1602 userspace app"
    help
      Userspace app that reads BME280 temp and mnet stats
      and displays them on a 1602 I2C LCD.
```
