## AESD_Final_Project/mnet_external/package/mnet/Config.in
```kconfig
config BR2_PACKAGE_MNET
    bool "mnet Ethernet driver"
    help
      A minimal Linux Ethernet driver (registers net_device 'mnet0')
      Implements ndo_open/stop/start_xmit hooks and TX/RX stats.
```
